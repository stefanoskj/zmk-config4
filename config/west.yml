## config/west.yml
```yaml
manifest:
  remotes:
    # zmk official
    - name: zmkfirmware
      url-base: https://github.com/zmkfirmware
    - name: urob
      url-base: https://github.com/urob
    - name: gpeye
      url-base: https://github.com/GPeye
  
  projects:
    - name: zmk
      remote: zmkfirmware
      revision: main
      import: app/west.yml
    - name: zmk-helpers          # ← AGGIUNGI QUESTO
      remote: urob               # ← AGGIUNGI QUESTO
      revision: main             # ← AGGIUNGI QUESTO
    - name: mario-peripheral-animation
      remote: gpeye
      revision: main
  
  self:
    path: config
```
